AUTOSAR XML (schema 4-0-3)
package /OS_CFG
  module config Os_0: definition=Os
    OsTask_0 (OsTask): OsTaskPriority=1, OsTaskActivation=1

AUTOSAR XML (schema 4-0-3)
package /OS_CFG
  module config Os
    5 x OsTask, all with OsTaskActivation=1:
      Task_ModeSelector: OsTaskPriority=5
      Task_RainSensor: OsTaskPriority=1
      Task_Wiper: OsTaskPriority=3
      Task_SwitchSensor: OsTaskPriority=2
      Task_Washer: OsTaskPriority=4

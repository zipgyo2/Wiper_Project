AUTOSAR XML (schema 4-0-3)
package /Compositions
  composition sw component type Comp
    7 x component:
      CPT_ECU_ABS: type=ECU_ABS
      CPT_Wiper_Mode: type=Wiper_Mode
      CPT_Wiper_Controller: type=Wiper_Controller
      CPT_Wiper_Switch_Sensor: type=Wiper_Switch_Sensor
      CPT_Rain_Sensor: type=Rain_Sensor
      CPT_Wiper_Motor: type=Wiper_Motor
      CPT_Wiper_Motor_0: type=Wiper_Motor
    connect CPT_ECU_ABS.Pport_ECU_to_RainSensor -> CPT_Rain_Sensor.Rport_ECU_to_RainSensor
    connect CPT_ECU_ABS.Pport_ECU_to_WiperMotor -> CPT_Wiper_Motor.Rport_ECU_to_WiperMotor
    connect CPT_ECU_ABS.Pport_ECU_to_WiperMotor -> CPT_Wiper_Motor_0.Rport_ECU_to_WiperMotor
    connect CPT_Rain_Sensor.Pport_RainSensor_to_WiperController -> CPT_Wiper_Controller.Rport_RainSensor_to_WiperController
    connect CPT_Wiper_Switch_Sensor.Pport_WiperSwitchSensor_to_WiperMode -> CPT_Wiper_Mode.Rport_WiperSwitchSensor_to_WiperMode
    connect CPT_Wiper_Mode.Pport_WiperMode_to_WiperController -> CPT_Wiper_Controller.Rport_WiperMode_to_WiperController
    connect CPT_Wiper_Controller.Pport_WiperController_to_WiperMotor -> CPT_Wiper_Motor.Rport_WiperController_to_WiperMotor
    connect CPT_Wiper_Controller.Pport_WiperController_to_WiperMotor -> CPT_Wiper_Motor_0.Rport_WiperController_to_WiperMotor
    connect CPT_ECU_ABS.Pport_ECU_to_WiperSwitchSensor -> CPT_Wiper_Switch_Sensor.Rport_ECU_to_WiperSwitchSensor

AUTOSAR XML (schema 4-0-3)
package /EcuInstance_0_FlatView/SwComponentTypes
  composition sw component type EcuInstance_TopLevelComposition_FlatView
    8 x component:
      CPT_ECU_ABS: type=ECU_ABS
      CPT_Mode_Controller: type=Mode_Controller
      CPT_Rain_Sensor: type=Rain_Sensor
      CPT_Switch_Sensor: type=Switch_Sensor
      CPT_Washer_Actuator: type=Washer_Actuator
      CPT_Wiper_Controller: type=Wiper_Controller
      CPT_Wiper_Motor: type=Wiper_Actuator
      CPT_Wiper_Motor_Rear: type=Wiper_Actuator
    connect CPT_ECU_ABS.Pport_ECU_to_WiperActuator -> CPT_Wiper_Motor.Rport_ECU_to_WiperActuator
    connect CPT_Switch_Sensor.Pport_SwitchSensor_to_ModeController -> CPT_Mode_Controller.RPort_SwitchSensor_to_ModeController
    connect CPT_Mode_Controller.PPort_ModeContorller_to_WiperContorller -> CPT_Wiper_Controller.Rport_ModeContorller_to_WiperController
    connect CPT_Wiper_Controller.Pport_WiperController_to_WiperActuator -> CPT_Wiper_Motor.Rport_WiperController_to_WiperActuator
    connect CPT_Rain_Sensor.Pport_RainSensor_to_WiperController -> CPT_Wiper_Controller.Rport_RainSensor_to_WiperController
    connect CPT_Wiper_Controller.Pport_WiperController_to_WiperActuator -> CPT_Wiper_Motor_Rear.Rport_WiperController_to_WiperActuator
    connect CPT_Wiper_Controller.Pport_WiperController_to_WasherActuator -> CPT_Washer_Actuator.RPort_WiperController_to_WasherActuator
    connect CPT_ECU_ABS.Pport_ECU_to_WasherActuator -> CPT_Washer_Actuator.RPort_ECU_to_WasherActuator
    connect CPT_ECU_ABS.Pport_ECU_to_WiperActuator -> CPT_Wiper_Motor_Rear.Rport_ECU_to_WiperActuator
    connect CPT_ECU_ABS.Pport_ECU_to_RainSensor -> CPT_Rain_Sensor.Rport_ECU_to_RainSensor
    connect CPT_ECU_ABS.Pport_ECU_to_SwitchSensor -> CPT_Switch_Sensor.Rport_ECU_to_SwitchSensor

AUTOSAR XML (schema 4-0-3)
package /EVC
  ecuc value collection EcucValueCollection: ecu-extract=EXTR_EcuInstance_0, ecuc-values=[Os_0, Rte_0]

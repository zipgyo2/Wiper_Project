AUTOSAR XML (schema 4-0-3)
package /EcuInstance_0_FlatView
  flat map EcuInstance_0_FlatMap
    14 x flat instance descriptor:
      CPT_ECU_ABS: upstream-reference=RootSwCompositionPrototype_0.CPT_ECU_ABS, ecu-extract-reference=CPT_EcuInstance_0_FlatView.CPT_ECU_ABS
      CPT_Mode_Controller: upstream-reference=RootSwCompositionPrototype_0.CPT_Mode_Controller, ecu-extract-reference=CPT_EcuInstance_0_FlatView.CPT_Mode_Controller
      CPT_Rain_Sensor: upstream-reference=RootSwCompositionPrototype_0.CPT_Rain_Sensor, ecu-extract-reference=CPT_EcuInstance_0_FlatView.CPT_Rain_Sensor
      rain_sensor_value: upstream-reference=RootSwCompositionPrototype_0.CPT_Rain_Sensor.Pport_RainSensor_to_WiperController.rain_sensor_value, ecu-extract-reference=CPT_EcuInstance_0_FlatView.CPT_Rain_Sensor.Pport_RainSensor_to_WiperController.rain_sensor_value
      CPT_Switch_Sensor: upstream-reference=RootSwCompositionPrototype_0.CPT_Switch_Sensor, ecu-extract-reference=CPT_EcuInstance_0_FlatView.CPT_Switch_Sensor
      switch_sensor_value: upstream-reference=RootSwCompositionPrototype_0.CPT_Switch_Sensor.Pport_SwitchSensor_to_WiperMode.switch_sensor_value, ecu-extract-reference=CPT_EcuInstance_0_FlatView.CPT_Switch_Sensor.Pport_SwitchSensor_to_WiperMode.switch_sensor_value
      CPT_Washer_Actuator: upstream-reference=RootSwCompositionPrototype_0.CPT_Washer_Actuator, ecu-extract-reference=CPT_EcuInstance_0_FlatView.CPT_Washer_Actuator
      CPT_Wiper_Controller: upstream-reference=RootSwCompositionPrototype_0.CPT_Wiper_Controller, ecu-extract-reference=CPT_EcuInstance_0_FlatView.CPT_Wiper_Controller
      CPT_Wiper_Controller_IB_Wiper_Controller_Shared_Wiper_Speeds: upstream-reference=RootSwCompositionPrototype_0.CPT_Wiper_Controller.Shared_Wiper_Speeds, ecu-extract-reference=CPT_EcuInstance_0_FlatView.CPT_Wiper_Controller.Shared_Wiper_Speeds
      CPT_Wiper_Controller_IB_Wiper_Controller_Shared_Wiper_Speed: upstream-reference=RootSwCompositionPrototype_0.CPT_Wiper_Controller.Shared_Wiper_Speed, ecu-extract-reference=CPT_EcuInstance_0_FlatView.CPT_Wiper_Controller.Shared_Wiper_Speed
      CPT_Wiper_Motor: upstream-reference=RootSwCompositionPrototype_0.CPT_Wiper_Motor, ecu-extract-reference=CPT_EcuInstance_0_FlatView.CPT_Wiper_Motor
      wipermotor_Speed_Value_RPort: upstream-reference=RootSwCompositionPrototype_0.CPT_Wiper_Motor.Rport_WiperController_to_WiperMotor.wipermotor_Speed_Value, ecu-extract-reference=CPT_EcuInstance_0_FlatView.CPT_Wiper_Motor.Rport_WiperController_to_WiperMotor.wipermotor_Speed_Value
      CPT_Wiper_Motor_Rear: upstream-reference=RootSwCompositionPrototype_0.CPT_Wiper_Motor_Rear, ecu-extract-reference=CPT_EcuInstance_0_FlatView.CPT_Wiper_Motor_Rear
      wipermotor_Speed_Value_0_RPort: upstream-reference=RootSwCompositionPrototype_0.CPT_Wiper_Motor_Rear.Rport_WiperController_to_WiperMotor.wipermotor_Speed_Value, ecu-extract-reference=CPT_EcuInstance_0_FlatView.CPT_Wiper_Motor_Rear.Rport_WiperController_to_WiperMotor.wipermotor_Speed_Value

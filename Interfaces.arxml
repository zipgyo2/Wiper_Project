AUTOSAR XML (schema 4-0-3)
package /ClientServerInterfaces
  4 x client server interface:
    CS_ECU_to_Sensor
      operation CS_Oper_ECU_to_SwitchSensor
        arg switch_sensor_value: type=uint8, direction=OUT
    CS_ECU_to_Actuator
      operation CS_Oper_ECU_to_WiperMotor
        arg wipermotor_speed_value: type=uint8, direction=IN
    CS_ECU_to_RainSensor
      operation CS_Oper_ECU_to_RainSensor
        arg rain_sensor_value: type=uint16, direction=OUT
    CS_ECU_to_Washer
      operation CS_Oper_ECU_to_Washer
        arg washer_value: type=uint8, direction=IN
package /SenderReceiverInterfaces
  sender receiver interface SR_App_to_Actuator
    data wipermotor_Speed_Value: type=uint8
  sender receiver interface SR_SwitchSensor_ModeController
    data switch_sensor_value: type=uint8
  sender receiver interface SR_Sensor_to_WiperController
    data rain_sensor_value: type=uint16
package /ModeSwitchInterfaces
  mode switch interface MD_ModeController_to_WiperController
    mode group MDGP: type=ModeDeclarationGroup
  data type mapping set ModeType: mode-request-type-map{implementation-data-type=uint8, mode-group=ModeDeclarationGroup}
package /ModeSwitchInterfaces/ModeDeclarationGroup
  mode declaration group ModeDeclarationGroup: category=ALPHABETIC_ORDER, initial-mode=Auto
    5 x mode:
      Auto: value=0
      Wiper_Lv{1..3}: value={1..3}
      Washer: value=4
package /TriggerInterfaces
  trigger interface TR_Washer
    trigger TR_Washer

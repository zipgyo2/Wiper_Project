AUTOSAR XML (schema 4-0-3)
package /ClientServerInterfaces
  client server interface CS_ECU_to_Sensor
    operation CS_Oper_ECU_to_SwitchSensor
      arg switch_sensor_value: type=uint8, direction=OUT
    operation CS_Oper_ECU_to_RainSensor
      arg rain_sensor_value: type=uint16, direction=OUT
  client server interface CS_ECU_to_Actuator
    operation CS_Oper_ECU_to_WiperMotor
      arg wipermotor_speed_value: type=uint8, direction=IN
  client server interface CS_Sensor_to_App
    operation CS_Oper_RainSensor_to_WiperController
      arg rain_sensor_value: type=uint16, direction=OUT
package /SenderReceiverInterfaces
  sender receiver interface SR_App_to_Actuator
    data wipermotor_Speed_Value: type=uint8
  sender receiver interface SR_ModeSensor_to_App
    data switch_sensor_value: type=uint8
  sender receiver interface SR_ModeController_to_WiperController
package /ModeSwitchInterfaces/ModeDeclarationGroup
  mode declaration group ModeDeclarationGroup: category=EXPLICIT_ORDER, initial-mode=Auto
    4 x mode:
      Auto: value=0
      Wiper_Lv{1..3}: value={1..3}

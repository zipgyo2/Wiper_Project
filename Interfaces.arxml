AUTOSAR XML (schema 4-0-3)
package /ClientServerInterfaces
  client server interface CS_ECU_to_Sensor
    operation CS_Oper_ModeSensor
      arg ArgumentDataPrototype_0: type=uint8, direction=OUT
    operation CS_Oper_RainSensor
      arg ArgumentDataPrototype_0: type=uint16, direction=OUT
  client server interface CS_ECU_to_Actuator
    operation CS_Oper_WiperMotor
      arg ArgumentDataPrototype_0: type=uint16, direction=OUT
  client server interface CS_Sensor_to_App
package /SenderReceiverInterfaces
  sender receiver interface SR_App_to_Actuator
    data Wiper_Speed_Value: type=uint8
  sender receiver interface SR_ModeSensor_to_App
    data Mode_Value: type=uint8
package /ModeSwitchInterfaces
  mode switch interface MS_App_to_App

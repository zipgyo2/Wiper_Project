AUTOSAR XML (schema 4-0-3)
package /Wiper_VSystem_EcuExtract
  system EXTR_EcuInstance: category=ECU_EXTRACT
    system mapping SYSMPG_EcuInstance
      sw-mappings:
        swc to ecu mapping SwcToEcuMapping_0: ecu-instance=EcuInstance
          component:
            CPT_EcuInstance_FlatView.CPT_ECU_ABS
            CPT_EcuInstance_FlatView.CPT_Mode_Controller
            CPT_EcuInstance_FlatView.CPT_Rain_Sensor
            CPT_EcuInstance_FlatView.CPT_Switch_Sensor
            CPT_EcuInstance_FlatView.CPT_Washer_Actuator
            CPT_EcuInstance_FlatView.CPT_Wiper_Controller
            CPT_EcuInstance_FlatView.CPT_Wiper_Motor
            CPT_EcuInstance_FlatView.CPT_Wiper_Motor_Rear
    root-software-compositions:
      root sw composition prototype CPT_EcuInstance_FlatView: flat-map=EcuInstance_FlatMap, software-composition=EcuInstance_FlatView

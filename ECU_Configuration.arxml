AUTOSAR XML (schema 4-0-3)
package /ECU_Configuration
  ecuc value collection Wiper_ECU: ecu-extract=EXTR_EcuInstance, ecuc-values=[Os, Rte]

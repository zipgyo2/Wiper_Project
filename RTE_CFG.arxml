AUTOSAR XML (schema 4-0-3)
package /RTE_CFG
  module config Rte_0: definition=Rte
    CPT_ECU_ABS (RteSwComponentInstance): RteSoftwareComponentInstanceRef=CPT_ECU_ABS
      4 x RteEventToTaskMapping, all with RteActivationOffset=0.0:
        OIE_ECU_to_SwitchSensor: RtePositionInTask=3, RteMappedToTaskRef=Task_SwitchSensor, RteEventRef=OIE_ECU_to_SwitchSensor
        OIE_ECU_to_Wipermotor: RtePositionInTask=3, RteMappedToTaskRef=Task_Wiper, RteEventRef=OIE_ECU_to_WiperActuator
        OIE_ECU_to_RainSensor: RtePositionInTask=2, RteMappedToTaskRef=Task_RainSensor, RteEventRef=OIE_ECU_to_RainSensor
        OIE_ECU_to_Washer: RtePositionInTask=2, RteMappedToTaskRef=Task_Washer, RteEventRef=OIE_ECU_to_WasherActuator
    RteGeneration_0 (RteGeneration):
      RteGenerationMode = VENDOR_MODE
      RteCalibrationSupport = NONE
      RteDevErrorDetect = 0
      RteDevErrorDetectUninit = 0
      RteIocInteractionReturnValue = RTE_COM
      RteMeasurementSupport = 1
      RteOptimizationMode = RUNTIME
      RteToolChainSignificantCharacters = 127
      RteVfbTraceEnabled = 0
    7 x RteSwComponentInstance:
      CPT_Wiper_Controller: RteSoftwareComponentInstanceRef=CPT_Wiper_Controller
        5 x RteEventToTaskMapping, all with RteActivationOffset=0.0, RteMappedToTaskRef=Task_ModeSelector:
          MSE_Mode_Washer: RtePositionInTask=2, RteEventRef=MSE_Mode_Washer
          MSE_Mode_Auto: RtePositionInTask=6, RteEventRef=MSE_Mode_Auto
          MSE_Mode_Lv1: RtePositionInTask=5, RteEventRef=MSE_Mode_Lv1
          MSE_Mode_Lv2: RtePositionInTask=4, RteEventRef=MSE_Mode_Lv2
          MSE_Mode_Lv3: RtePositionInTask=3, RteEventRef=MSE_Mode_Lv3
      CPT_Rain_Sensor: RteSoftwareComponentInstanceRef=CPT_Rain_Sensor
        TE_1s (RteEventToTaskMapping): RtePositionInTask=1, RteActivationOffset=0.0, RteMappedToTaskRef=Task_RainSensor, RteEventRef=TE_1s
      CPT_Switch_Sensor: RteSoftwareComponentInstanceRef=CPT_Switch_Sensor
        TE_100ms (RteEventToTaskMapping): RtePositionInTask=2, RteActivationOffset=0.0, RteMappedToTaskRef=Task_SwitchSensor, RteEventRef=TE_100ms
      CPT_Wiper_Motor_Rear: RteSoftwareComponentInstanceRef=CPT_Wiper_Motor_Rear
        DRE_Wiper (RteEventToTaskMapping): RtePositionInTask=2, RteActivationOffset=0.0, RteMappedToTaskRef=Task_Wiper, RteEventRef=DRE_WiperActuator
      CPT_Wiper_Motor: RteSoftwareComponentInstanceRef=CPT_Wiper_Motor
        DRE_Wiper (RteEventToTaskMapping): RtePositionInTask=1, RteActivationOffset=0.0, RteMappedToTaskRef=Task_Wiper, RteEventRef=DRE_WiperActuator
      CPT_Mode_Controller: RteSoftwareComponentInstanceRef=CPT_Mode_Controller
        DRE_SwitchSensor_to_ModeController (RteEventToTaskMapping): RtePositionInTask=1, RteActivationOffset=0.0, RteMappedToTaskRef=Task_ModeSelector, RteEventRef=DRE_SwitchSensor_to_ModeController
      CPT_Washer_Actuator: RteSoftwareComponentInstanceRef=CPT_Washer_Actuator
        TR_Wahser_Actuator (RteEventToTaskMapping): RtePositionInTask=1, RteActivationOffset=0.0, RteMappedToTaskRef=Task_Washer, RteEventRef=TR_Wahser_Actuator

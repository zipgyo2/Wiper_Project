AUTOSAR XML (schema 4-0-3)
package /RTE_CFG
  module config Rte_0: definition=Rte
    CPT_ECU_ABS (RteSwComponentInstance): RteSoftwareComponentInstanceRef=CPT_ECU_ABS
      4 x RteEventToTaskMapping, all with RteActivationOffset=0.0, RteMappedToTaskRef=OsTask_0:
        OIE_ECU_to_SwitchSensor: RtePositionInTask=1, RteEventRef=OIE_ECU_to_SwitchSensor
        OperationInvokedEvent_1: RtePositionInTask=6, RteEventRef=OperationInvokedEvent_1
        OIE_ECU_to_Wipermotor: RtePositionInTask=9, RteEventRef=OIE_ECU_to_Wipermotor
        OperationInvokedEvent_0: RtePositionInTask=11, RteEventRef=OperationInvokedEvent_0
    RteGeneration_0 (RteGeneration):
      RteGenerationMode = VENDOR_MODE
      RteCalibrationSupport = NONE
      RteDevErrorDetect = 0
      RteDevErrorDetectUninit = 0
      RteIocInteractionReturnValue = RTE_COM
      RteMeasurementSupport = 1
      RteOptimizationMode = RUNTIME
      RteToolChainSignificantCharacters = 127
      RteVfbTraceEnabled = 0
    7 x RteSwComponentInstance:
      CPT_Wiper_Controller: RteSoftwareComponentInstanceRef=CPT_Wiper_Controller
        5 x RteEventToTaskMapping, all with RteActivationOffset=0.0, RteMappedToTaskRef=OsTask_0:
          SwcModeSwitchEvent_0: RtePositionInTask=2, RteEventRef=SwcModeSwitchEvent_0
          MSE_Mode_Lv2: RtePositionInTask=7, RteEventRef=MSE_Mode_Lv2
          MSE_Mode_Auto: RtePositionInTask=5, RteEventRef=MSE_Mode_Auto
          MSE_Mode_Lv1: RtePositionInTask=3, RteEventRef=MSE_Mode_Lv1
          MSE_Mode_Lv3: RtePositionInTask=4, RteEventRef=MSE_Mode_Lv3
      CPT_Washer_Actuator: RteSoftwareComponentInstanceRef=CPT_Washer_Actuator
        ExternalTriggerOccurredEvent_0 (RteEventToTaskMapping): RtePositionInTask=8, RteActivationOffset=0.0, RteMappedToTaskRef=OsTask_0, RteEventRef=ExternalTriggerOccurredEvent_0
      CPT_Mode_Controller: RteSoftwareComponentInstanceRef=CPT_Mode_Controller
        DataReceivedEvent_0 (RteEventToTaskMapping): RtePositionInTask=10, RteActivationOffset=0.0, RteMappedToTaskRef=OsTask_0, RteEventRef=DataReceivedEvent_0
      CPT_Rain_Sensor: RteSoftwareComponentInstanceRef=CPT_Rain_Sensor
        TimingEvent_0 (RteEventToTaskMapping): RtePositionInTask=12, RteActivationOffset=0.0, RteMappedToTaskRef=OsTask_0, RteEventRef=TimingEvent_0
      CPT_Switch_Sensor: RteSoftwareComponentInstanceRef=CPT_Switch_Sensor
        TE_100ms (RteEventToTaskMapping): RtePositionInTask=13, RteActivationOffset=0.0, RteMappedToTaskRef=OsTask_0, RteEventRef=TE_100ms
      CPT_Wiper_Motor: RteSoftwareComponentInstanceRef=CPT_Wiper_Motor
        DataReceivedEvent_0 (RteEventToTaskMapping): RtePositionInTask=14, RteActivationOffset=0.0, RteMappedToTaskRef=OsTask_0, RteEventRef=DataReceivedEvent_0
      CPT_Wiper_Motor_Rear: RteSoftwareComponentInstanceRef=CPT_Wiper_Motor_Rear
        DataReceivedEvent_0 (RteEventToTaskMapping): RtePositionInTask=15, RteActivationOffset=0.0, RteMappedToTaskRef=OsTask_0, RteEventRef=DataReceivedEvent_0

AUTOSAR XML (schema 4-0-3)
package /RTE_CFG
  module config Rte
    CPT_Mode_Controller (RteSwComponentInstance): RteSoftwareComponentInstanceRef=CPT_Mode_Controller
      DRE_SwitchSensor_to_ModeController (RteEventToTaskMapping): RtePositionInTask=6, RteActivationOffset=0.0, RteMappedToTaskRef=Task_ModeSelector, RteEventRef=DRE_SwitchSensor_to_ModeController
    RteGeneration_0 (RteGeneration):
      RteGenerationMode = VENDOR_MODE
      RteCalibrationSupport = NONE
      RteDevErrorDetect = 0
      RteDevErrorDetectUninit = 0
      RteIocInteractionReturnValue = RTE_COM
      RteMeasurementSupport = 1
      RteOptimizationMode = RUNTIME
      RteToolChainSignificantCharacters = 127
      RteVfbTraceEnabled = 0
    6 x RteSwComponentInstance:
      CPT_Wiper_Controller: RteSoftwareComponentInstanceRef=CPT_Wiper_Controller
        5 x RteEventToTaskMapping, all with RteActivationOffset=0.0, RteMappedToTaskRef=Task_ModeSelector:
          MSE_Mode_Washer: RtePositionInTask=5, RteEventRef=MSE_Mode_Washer
          MSE_Mode_Lv3: RtePositionInTask=4, RteEventRef=MSE_Mode_Lv3
          MSE_Mode_Lv2: RtePositionInTask=3, RteEventRef=MSE_Mode_Lv2
          MSE_Mode_Lv1: RtePositionInTask=2, RteEventRef=MSE_Mode_Lv1
          MSE_Mode_Auto: RtePositionInTask=1, RteEventRef=MSE_Mode_Auto
      CPT_Rain_Sensor: RteSoftwareComponentInstanceRef=CPT_Rain_Sensor
        TE_1s (RteEventToTaskMapping): RtePositionInTask=2, RteActivationOffset=0.0, RteMappedToTaskRef=Task_RainSensor, RteEventRef=TE_1s
      CPT_Switch_Sensor: RteSoftwareComponentInstanceRef=CPT_Switch_Sensor
        Task_SwitchSensor (RteEventToTaskMapping): RtePositionInTask=1, RteActivationOffset=0.0, RteMappedToTaskRef=Task_SwitchSensor, RteEventRef=TE_100ms
      CPT_Washer_Actuator: RteSoftwareComponentInstanceRef=CPT_Washer_Actuator
        TR_Wahser_Actuator (RteEventToTaskMapping): RtePositionInTask=1, RteActivationOffset=0.0, RteMappedToTaskRef=Task_Washer, RteEventRef=TR_Wahser_Actuator
      CPT_Wiper_Motor_Rear: RteSoftwareComponentInstanceRef=CPT_Wiper_Motor_Rear
        DRE_WiperActuator (RteEventToTaskMapping): RtePositionInTask=2, RteActivationOffset=0.0, RteMappedToTaskRef=Task_Wiper, RteEventRef=DRE_WiperActuator
      CPT_Wiper_Motor: RteSoftwareComponentInstanceRef=CPT_Wiper_Motor
        DRE_WiperActuator (RteEventToTaskMapping): RtePositionInTask=1, RteActivationOffset=0.0, RteMappedToTaskRef=Task_Wiper, RteEventRef=DRE_WiperActuator

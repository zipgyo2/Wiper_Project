AUTOSAR XML (schema 4-0-3)
package /System_Configuration
  system Wiper_VSystem: category=SYSTEM_EXTRACT
    system mapping SystemMapping
      sw-mappings:
        swc to ecu mapping SwcToEcuMapping_0: ecu-instance=EcuInstance
          component:
            RootSwCompositionPrototype_0.CPT_ECU_ABS
            RootSwCompositionPrototype_0.CPT_Mode_Controller
            RootSwCompositionPrototype_0.CPT_Rain_Sensor
            RootSwCompositionPrototype_0.CPT_Switch_Sensor
            RootSwCompositionPrototype_0.CPT_Washer_Actuator
            RootSwCompositionPrototype_0.CPT_Wiper_Controller
            RootSwCompositionPrototype_0.CPT_Wiper_Motor
            RootSwCompositionPrototype_0.CPT_Wiper_Motor_Rear
    root-software-compositions:
      root sw composition prototype RootSwCompositionPrototype_0: software-composition=TopLevelComposition
  ecu instance EcuInstance

AUTOSAR XML (schema 4-0-3)
package /Vrsys_EcuExtract
  system EXTR_EcuInstance_0: category=ECU_EXTRACT
    system mapping SYSMPG_EcuInstance_0
      sw-mappings:
        swc to ecu mapping SwcToEcuMapping_0: ecu-instance=EcuInstance_0
          component:
            CPT_EcuInstance_0_FlatView.CPT_ECU_ABS
            CPT_EcuInstance_0_FlatView.CPT_Mode_Controller
            CPT_EcuInstance_0_FlatView.CPT_Rain_Sensor
            CPT_EcuInstance_0_FlatView.CPT_Switch_Sensor
            CPT_EcuInstance_0_FlatView.CPT_Washer_Actuator
            CPT_EcuInstance_0_FlatView.CPT_Wiper_Controller
            CPT_EcuInstance_0_FlatView.CPT_Wiper_Motor
            CPT_EcuInstance_0_FlatView.CPT_Wiper_Motor_Rear
    root-software-compositions:
      root sw composition prototype CPT_EcuInstance_0_FlatView: flat-map=EcuInstance_0_FlatMap, software-composition=EcuInstance_TopLevelComposition_FlatView
